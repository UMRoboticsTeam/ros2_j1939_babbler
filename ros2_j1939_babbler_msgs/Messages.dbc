VERSION "1.0"

NS_ :

BS_:

BU_: ECU1 ECU2 ECU3

BO_ 256 EngineData: 8 ECU1
 SG_ Engine_RPM : 0|16@1+ (0.25,0) [0|8000] "rpm" ECU1
 SG_ Engine_Temp : 16|8@1+ (1,-40) [-40|215] "C" ECU1

BO_ 512 WheelData: 8 ECU2
 SG_ Wheel_Speed_FL : 0|16@1+ (0.1,0) [0|250] "km/h" ECU2
 SG_ Wheel_Speed_FR : 16|16@1+ (0.1,0) [0|250] "km/h" ECU2

BO_ 64 BatteryVoltage: 8 ECU3
  SG_ Voltage : 0|16@1+ (0.001,0) [0|64] "V" ECU3

BO_ 128 BatteryTemp: 8 ECU3
  SG_ Temperature : 0|16@1+ (0.01,-100) [-100|500] "C" ECU3

SIG_VALTYPE_ 256 Engine_RPM  : 1;
SIG_VALTYPE_ 256 Engine_Temp  : 0;
SIG_VALTYPE_ 512 Wheel_Speed_FL  : 1;
SIG_VALTYPE_ 512 Wheel_Speed_FR  : 1;
SIG_VALTYPE_ 64 Voltage  : 1;
SIG_VALTYPE_ 128 Temperature  : 1;

BA_DEF_ BO_ "VFrameFormat" ENUM "StandardCAN","ExtendedCAN","reserved","J1939PG";

BA_DEF_DEF_ "VFrameFormat" "J1939PG";

BA_ "VFrameFormat" BO_ 64 2
BA_ "VFrameFormat" BO_ 128 2
